## meta-blackpole/conf/machine/vuduo.conf
```bitbake
#@TYPE: Machine
#@NAME: Vu+ Duo
#@DESCRIPTION: Machine configuration for the Vu+ Duo

UPDATE_DIR = "duo"

require conf/machine/include/vuxxo.inc

EXTRA_IMAGEDEPENDS += "\
	enigma2-plugin-systemplugins-fancontrol \
	"

MACHINE_FEATURES += "textlcd dvd"

CHIPSET = "bcm7335"

MACHINE_KERNEL_PR = "r4"
```

## meta-blackpole/conf/machine/vuultimo.conf
```bitbake
#@TYPE: Machine
#@NAME: Vu+ Ultimo
#@DESCRIPTION: Machine configuration for the Vu+ Ultimo

UPDATE_DIR = "ultimo"

require conf/machine/include/vuxxo.inc

MACHINE_ESSENTIAL_EXTRA_RRECOMMENDS += "\
	vuplus-fpga-update \
	vuplus-blindscan-utils-vuultimo \
"

MACHINE_FEATURES += "dvb-c blindscan-dvbc blindscan-dvbs dvd"

CHIPSET = "bcm7413"

MACHINE_KERNEL_PR = "r4"
```

## meta-blackpole/conf/machine/vuuno.conf
```bitbake
#@TYPE: Machine
#@NAME: Vu+ Uno
#@DESCRIPTION: Machine configuration for the Vu+ Uno

UPDATE_DIR = "uno"

require conf/machine/include/vuxxo.inc

MACHINE_ESSENTIAL_EXTRA_RRECOMMENDS += "\
	vuplus-fpga-update \
	vuplus-blindscan-utils-vuuno \
	"

MACHINE_FEATURES += "textlcd dvb-c blindscan-dvbc blindscan-dvbs dvd"

CHIPSET = "bcm7413"

MACHINE_KERNEL_PR = "r4"
```
